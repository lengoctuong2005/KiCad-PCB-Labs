## DoAn/AFE_ECG_PPG_PTT/firmware/esp32_ptt_streamer/main/Kconfig.projbuild
```kconfig
menu "AFE ECG PPG PTT Configuration"

    config WIFI_SSID
        string "WiFi SSID"
        default "AFE_PTT_NET"
        help
            Wi-Fi network SSID for the ESP32 station.

    config WIFI_PASS
        string "WiFi Password"
        default "12345678"
        help
            Wi-Fi WPA2 PSK password for the target network.

    config TARGET_IP
        string "Target Host IP"
        default "192.168.4.2"
        help
            Destination IPv4 address receiving UDP telemetry packets.

    config UDP_PORT
        int "UDP Telemetry Port"
        range 1 65535
        default 5005
        help
            Destination UDP port receiving telemetry packets.

endmenu
```

## DoAn/AFE_ECG_PPG_PTT/firmware/esp32_ptt_streamer/sdkconfig.defaults
```kconfig
CONFIG_FREERTOS_HZ=1000
CONFIG_ESP_DEFAULT_CPU_FREQ_MHZ_240=y
CONFIG_ESP_DEFAULT_CPU_FREQ_MHZ=240
CONFIG_ESP_MAIN_TASK_STACK_SIZE=4096
CONFIG_ESP32_DEFAULT_CPU_FREQ_240=y
CONFIG_COMPILER_OPTIMIZATION_PERF=y
```
